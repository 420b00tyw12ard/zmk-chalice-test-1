## zmk-config-chalice_nn2_default/config/west.yml
```yaml
manifest:
  remotes:
    - name: zmkfirmware
      url-base: https://github.com/zmkfirmware
    - name: joshajohnson
      url-base: https://github.com/joshajohnson
  projects:
    - name: zmk
      remote: joshajohnson
      revision: chalice
      import: app/west.yml
  self:
    path: config
```
